## components/espb/Kconfig
```kconfig
# This is the configuration file for the ESPB interpreter.

menu "ESPB Configuration"

    config ESPB_INTERPRETER_ENABLED
        bool "Enable ESPB Interpreter"
        default y
        help
            Enable the ESPB interpreter functionality.

    config ESPB_JIT_ENABLED
        bool "Enable JIT Compilation"
        depends on ESPB_INTERPRETER_ENABLED
        default y
        help
            Enable Just-In-Time (JIT) compilation for ESPB functions.
            This can significantly improve performance for frequently called functions.

    config ESPB_IDF_GPIO
        bool "Enable GPIO symbols in idf_fast table"
        depends on ESPB_INTERPRETER_ENABLED
        default y
        help
            If enabled, the idf_fast symbol table will contain GPIO-related entries.
            If disabled, the corresponding slots in the table will be generated as NULL.

    config ESPB_LINEAR_MEMORY_SIZE
        int "Linear memory size (bytes)"
        depends on ESPB_INTERPRETER_ENABLED
        default 65536
        range 1024 4194304
        help
            The size of the linear memory allocated for the ESPB interpreter.
            This memory is used for the WebAssembly linear memory space.
            Default is 64KB, which is sufficient for simple applications.
            For more complex applications, you may need to increase this value.
            Minimum allowed value is 1KB, maximum is 4MB.

    # --- Interpreter Settings ---
    menu "Interpreter Settings"
        depends on ESPB_INTERPRETER_ENABLED
        
        config ESPB_SHADOW_STACK_INITIAL_SIZE
            int "Initial shadow stack size (bytes)"
            default 4096
            help
                The initial size of the shadow stack used by the ESPB interpreter
                for saving registers during function calls. This stack will grow
                dynamically if needed, but setting an appropriate initial size
                can reduce the number of reallocations.

        config ESPB_SHADOW_STACK_INCREMENT
            int "Shadow stack increment size (bytes)"
            default 4096
            range 256 65536
            help
                When the shadow stack needs to grow, it will be increased by this fixed amount.
                Larger values reduce the number of reallocations but may waste memory if not fully used.
                Smaller values use memory more efficiently but cause more frequent reallocations.
                For simple scripts with shallow call depth, values of 256-1024 bytes will be optimal.
                For complex applications with deep function nesting, values of 4-16 KB are recommended.
                In extreme cases, you can use up to 64 KB.
                
        config ESPB_DEBUG_CHECKS
            bool "Enable runtime debug checks"
            default n
            help
                Enable runtime validation checks in the interpreter.
                These checks validate register indices, memory bounds, and other
                runtime conditions on every instruction execution.
                
                WARNING: Enabling this significantly reduces performance and increases
                code size. Only enable for debugging purposes.
                
                When disabled, the interpreter assumes that the bytecode has been
                properly validated during module loading. Invalid bytecode may cause
                undefined behavior or crashes.
                
                Recommended settings:
                - Development/Debug: Enable (y)
                - Production/Release: Disable (n)
    endmenu

endmenu 
```

## components/libffi/Kconfig
```kconfig
menu "libffi Configuration"

    depends on ESPB_INTERPRETER_ENABLED
    
    config LIBFFI_USE_IRAM_POOL
        bool "Use IRAM memory pool for closures"
        default y if IDF_TARGET_RISCV || IDF_TARGET_XTENSA
        default n
        help
            Enable this to allocate memory for libffi closures from a dedicated
            pool in IRAM. This is required for targets like ESP32-C3 and ESP32-C2
            which cannot execute code from DRAM. For other targets, standard
            heap memory will be used.

    config LIBFFI_IRAM_POOL_SIZE
        int "IRAM memory pool size (bytes)"
        depends on LIBFFI_USE_IRAM_POOL
        default 4096
        help
            The size of the memory pool in IRAM to be reserved for libffi closures.
            This memory is used to generate executable trampolines at runtime.
            Fixed free-list implementation should work properly with 4KB pool.
            If you experience crashes related to running out of executable memory
            for closures, try increasing this value.

endmenu 
```

## sdkconfig.defaults
```kconfig
# This file is used to set default values for project configuration options.
# These values will be used if the options are not already set in sdkconfig.
# You can find documentation about all available options in the ESP-IDF documentation.

CONFIG_HEAP_PLACE_FUNCTION_IN_IRAM=y 
```
